## Documentation/devicetree/bindings/phy/phy-stm32-usbphyc.txt
```
STMicroelectronics STM32 USB HS PHY controller

The STM32 USBPHYC block contains a dual port High Speed UTMI+ PHY
USB2_2PHY_40lp50A and a UTMI switch.
It controls PHY configuration and status, and the UTMI+ switch that selects
either OTG or HOST controller for the second PHY port. It also sets PLL
configuration.

USBPHYC
  |_ PLL
  |
  |_ PHY port#1 _________________ HOST controller
  |                                      |
  |_ PHY port#2_______                   |
  |                   |_                 |
  |_ UTMI switch_____/ 1|________________|
                    |   |________________
                     \_0|                |
		                  OTG controller

Required properties:
- compatible: must be "st,stm32mp1-usbphyc"
- reg: address and length of the usb phy control register set
- clocks: phandle + clock specifier for the PLL phy clock

Optional properties:
- assigned-clocks: phandle + clock specifier for the PLL phy clock
- assigned-clock-parents: the PLL phy clock parent
- resets: phandle + reset specifier
- st,port2-switch-to-host: select HOST controller on UTMI switch for port#2


Example:
		usbphyc: usbphyc@5a006000 {
			compatible = "st,stm32mp1-usbphyc";
			reg = <0x5a006000 0x1000>;
			clocks = <&rcc_clk USBPHY_K>;
			resets = <&rcc_rst USBPHY_R>;
			st,port2-switch-to-host;
		};
```

## Documentation/devicetree/bindings/power/st,stm32mp1-pwr.txt
```
STMicroelectronics STM32MP1 Power Management Controller
=======================================================

The PWR IP is responsible for handling the power related resources such as
clocks, power supplies and resets.

Required properties:
- compatible should be: "st,stm32mp1-pwr", "st,stm32-pwr"
- reg: should be register base and length as documented in the
  datasheet
- system-power-controller: this IP handles the power resources
- interrupts: contains the references to the PWR wake-up interrupt and the
  generic interrupt
- st,sysrcc: should be a phandle of the rcc node.
- clocks: clock phandle of phyclk for ddr subsystem
- clock-names: should be "phyclk"

Optional Properties:
- pwr-supply: main soc power supply
- Kernel power mode nodes:
  - standby_state: corresppond to PM_SUSPEND_STANDBY mode
  - suspend_to_ram_state: correspond to PM_SUSPEND_MEM mode

  in each mode we can overload ddr, regulator and soc mode :
  ddr_mode	 : 0 -> Self Refresh, 1 -> OFF
  regulator_mode : 2 -> PM_SUSPEND_STANDBY, 3 --> PM_SUSPEND_MEM, 4 --> PM_SUSPEND_MAX
  soc_power_mode : 0 -> CSTOP, 1 -> CSTANDBY, 2 -> LPSTOP

Example:

	pwr: pwr@50001000 {
		compatible = "st,stm32mp1-pwr", "st,stm32-pwr", "syscon", "simple-mfd";
		reg = <0x50001000 0x400>;
		system-power-controller;
		interrupts = <GIC_SPI 149 IRQ_TYPE_NONE>,
			     <GIC_SPI 148 IRQ_TYPE_NONE>;

		st,sysrcc = <&rcc>;
		pwr-supply = <&vdd>;
		clocks = <&rcc_clk PLL2_R>;
		clock-names = "phyclk";

		standby_state {
			ddr_mode       = <0>;
			regulator_mode = <2>;
			soc_power_mode = <0>;
		};

		suspend_to_ram_state {
			ddr_mode       = <0>;
			regulator_mode = <3>;
			soc_power_mode = <1>;
		};
	};
```

## Documentation/devicetree/bindings/regulator/protection-consumer.txt
```
protection consumer bindings

Required properties:
- compatible: should be "protection-consumer"
- protection-supply: phandle to the parent supply/regulator node to protect

Optional properties:
--------------------
- interrupt-parent: phandle to the parent interrupt controller
- interrupts: interrupt line to use as a failure detection

Example:

	vcc_protection {
		compatible = "protection-consumer";
		protection-supply = <&vcc>;
		status = "okay";

		interrupts = <15 2>;
		interrupt-parent = <&gpiof>;
	};
```

## Documentation/devicetree/bindings/regulator/stpmu1-regulator.txt
```
STMicroelectronics STPMU1 Voltage regulators

Regulator Nodes are optional depending on regulators you want to connect to
your SoC

Available Regulators in STPMU1 device are:
  - buck1 for Buck BUCK1
  - buck2 for Buck BUCK2
  - buck3 for Buck BUCK3
  - buck4 for Buck BUCK4
  - ldo1 for LDO LDO1
  - ldo2 for LDO LDO2
  - ldo3 for LDO LDO3
  - ldo4 for LDO LDO4
  - ldo5 for LDO LDO5
  - ldo6 for LDO LDO6
  - vref_ddr for LDO Vref DDR
  - boost for Buck BOOST
  - vbus_otg for VBUS_OTG switch
  - sw_out for SW_OUT switch

Switches are fixed voltage regulators with only enable/disable capability.

Optional properties:
- Any optional property defined in bindings/regulator/regulator.txt
- st,mask_rank: enable masking of rank during Reset for particular regulator
- st,mask_reset: stay on during Reset for particular regulator
- regulator-pull-down: enable high pull down
  if not specified light pull down is used
- st,regulator-boot-off: switch off the regulator during kernel start-up
- regulator-over-current-protection:
    if set, all regulators are switched off in case of over-current detection
    on this regulator,
    if not set, pmic driver generates an interruption when over-current is
    detected. The regulator is kept on.
- <regulator>-supply: phandle to the parent supply/regulator node
	each regulator supply can be described except vref_ddr.

Example:
regulators {
	compatible = "st,stpmu1-regulators";

	ldo6-supply = <&v3v3>;

	vdd_core: regulator@0 {
		regulator-compatible = "buck1";
		regulator-name = "vdd_core";
		st,mask_rank;
		st,mask_reset;
		regulator-pull-down;
		st,pulldown_config = <2>;
		st,regulator-boot-off;
		regulator-min-microvolt = <700000>;
		regulator-max-microvolt = <1200000>;
		regulator-state-mem {
			regulator-on-in-suspend;
			regulator-suspend-microvolt = <700000>;
		};
		regulator-state-disk {
			regulator-off-in-suspend;
		};
	};

	v3v3: buck4 {
		regulator-compatible = "buck4";
		regulator-name = "v3v3";
		regulator-min-microvolt = <3300000>;
		regulator-max-microvolt = <3300000>;

		regulator-state-mem {
			regulator-suspend-microvolt = <3300000>;
			regulator-on-in-suspend;
		};
		regulator-state-disk {
			regulator-off-in-suspend;
		};
	};

	v1v8: ldo6 {
		regulator-compatible = "ldo6";
		regulator-name = "v1v8";
		regulator-min-microvolt = <1800000>;
		regulator-max-microvolt = <1800000>;
		regulator-over-current-protection;

		regulator-state-mem {
			regulator-off-in-suspend;
		};
		regulator-state-disk {
			regulator-off-in-suspend;
		};
	};


};
```

## Documentation/devicetree/bindings/remoteproc/rproc-srm.txt
```
Remoteproc System Resource Manager
----------------------------------

The remoteproc SRM (System Resource Manager) handles resources allocated
to remote processors.
This makes it possible for remote proc to reserve and initialize system
resources for a peripheral assigned to a coprocessor.

The devices are grouped in a core node

Core
====
Required properties:
- compatible: should be "rproc-srm-core"

Dev
===
Required properties:
- compatible: should be "rproc-srm-dev"

Optional properties:
- clocks: clocks required by the coprocessor
- clock-names: see clock-bindings.txt
- assigned-clocks: see clock-bindings.txt
- assigned-clock-parents: see clock-bindings.txt
- assigned-clock-rates: see clock-bindings.txt
- pinctrl-x: pins configurations required by the coprocessor
- pinctrl-names: see pinctrl-bindings.txt
- x-supply: power supplies required by the coprocessor
- interrupts: see interrupts.txt
- interrupt-parent: see interrupts.txt
- interrupt-names: see interrupts.txt

Example:
	system_resources {
		compatible = "rproc-srm-core";

		mmc0: sdhci@09060000 {
			compatible = "rproc-srm-dev";
			pinctrl-names = "default", "idle";
			pinctrl-0 = <&pinctrl_mmc0>;
			pinctrl-1 = <&pinctrl_mmc1>;
			clock-names = "mmc", "icn";
			clocks = <&clk_s_c0_flexgen CLK_MMC_0>,
				 <&clk_s_c0_flexgen CLK_RX_ICN_HVA>;
			vdda-supply = <&vdda>;
		};
		button {
			compatible = "rproc-srm-dev";
			interrupt-parent = <&gpioa>;
			interrupts = <5 1>;
			interrupt-names = "gpio_key";
		};
	};
```

## Documentation/devicetree/bindings/remoteproc/stm32-rproc.txt
```
STMicroelectronics STM32 Remoteproc
-----------------------------------

The STM32MP family use a MCU arm Cortex M

Required properties:
- compatible: should be "st,stm32-m4-rproc"
- reg: should contain the address ranges for the two internal
  memory regions, RETRAM and SRAM
- reg-names: contains the corresponding names for the two memory
  regions. these should be named "retram" & "mcusram".
- resets: reference to a reset controller asserting the MCU.
- reset-names: must be "mcu_rst"
- st,hold_boot: system configuration register which holds the mcu in reset
	1st cell: phandle to syscon block
	2nd cell: register offset of BOOT_MCU
	3rd cell: mask for BOOT_MCU bit

Optional properties:
- st,smc_boot: defined if the hold boot must be done by secure monitor
  call the smc with st,hold_boot parameters
- interrupts: should contain the watchdog interrupt
- interrupt-names: must be "wdg"

Example:
	m4_rproc: m4 {
		compatible = "st,stm32-m4-rproc";
		reg = <0x38000000 0x10000>,
		      <0x10000000 0x40000>;
		reg-names = "retram", "mcusram";
		resets = <&rcc MCU_R>;
		reset-names = "mcu_rst";
		st,hold_boot = <&rcc 0x10C 0x1>;
	};
```

## arch/arm/configs/stm32mp1_defconfig
```kconfig
# CONFIG_FHANDLE is not set
CONFIG_USELIB=y
CONFIG_NO_HZ_IDLE=y
CONFIG_HIGH_RES_TIMERS=y
CONFIG_LOG_BUF_SHIFT=16
CONFIG_BLK_DEV_INITRD=y
CONFIG_CC_OPTIMIZE_FOR_SIZE=y
# CONFIG_UID16 is not set
# CONFIG_BASE_FULL is not set
# CONFIG_EPOLL is not set
# CONFIG_SIGNALFD is not set
# CONFIG_AIO is not set
# CONFIG_MEMBARRIER is not set
CONFIG_EMBEDDED=y
# CONFIG_PERF_EVENTS is not set
# CONFIG_VM_EVENT_COUNTERS is not set
# CONFIG_SLUB_DEBUG is not set
CONFIG_PROFILING=y
CONFIG_MODULES=y
CONFIG_MODULE_UNLOAD=y
CONFIG_ARCH_STM32=y
# CONFIG_CACHE_L2X0 is not set
CONFIG_SMP=y
CONFIG_PREEMPT=y
# CONFIG_ARM_PATCH_IDIV is not set
# CONFIG_CPU_SW_DOMAIN_PAN is not set
# CONFIG_ATAGS is not set
CONFIG_ZBOOT_ROM_TEXT=0x0
CONFIG_ZBOOT_ROM_BSS=0x0
CONFIG_VFP=y
CONFIG_NEON=y
CONFIG_KERNEL_MODE_NEON=y
# CONFIG_COREDUMP is not set
CONFIG_NET=y
CONFIG_PACKET=y
CONFIG_UNIX=y
CONFIG_INET=y
CONFIG_IP_PNP=y
CONFIG_IP_PNP_DHCP=y
# CONFIG_IPV6 is not set
CONFIG_CAN=y
CONFIG_CAN_M_CAN=y
# CONFIG_WIRELESS is not set
CONFIG_DEVTMPFS=y
CONFIG_DEVTMPFS_MOUNT=y
CONFIG_MTD=y
CONFIG_MTD_NAND=y
CONFIG_MTD_NAND_STM32_FMC=y
CONFIG_MTD_SPI_NOR=y
CONFIG_SPI_STM32_QUADSPI=y
CONFIG_MTD_UBI=y
CONFIG_OF_OVERLAY=y
CONFIG_OF_CONFIGFS=y
CONFIG_SCSI=y
CONFIG_BLK_DEV_SD=y
CONFIG_CHR_DEV_SG=y
CONFIG_NETDEVICES=y
# CONFIG_NET_CORE is not set
CONFIG_STMMAC_ETH=y
CONFIG_USB_USBNET=y
# CONFIG_USB_NET_AX88179_178A is not set
# CONFIG_USB_NET_CDCETHER is not set
# CONFIG_USB_NET_CDC_NCM is not set
# CONFIG_USB_NET_NET1080 is not set
# CONFIG_USB_NET_CDC_SUBSET is not set
# CONFIG_USB_NET_ZAURUS is not set
# CONFIG_WLAN is not set
CONFIG_INPUT_EVDEV=y
# CONFIG_KEYBOARD_ATKBD is not set
CONFIG_KEYBOARD_GPIO=y
# CONFIG_MOUSE_PS2 is not set
CONFIG_INPUT_MISC=y
CONFIG_INPUT_STPMU1_ONKEY=y
# CONFIG_SERIO is not set
# CONFIG_VT is not set
# CONFIG_UNIX98_PTYS is not set
CONFIG_SERIAL_NONSTANDARD=y
CONFIG_SERIAL_STM32=y
CONFIG_SERIAL_STM32_CONSOLE=y
CONFIG_HW_RANDOM=y
CONFIG_HW_RANDOM_STM32=y
CONFIG_I2C_CHARDEV=y
CONFIG_I2C_STM32F7=y
CONFIG_SPI=y
CONFIG_SPI_STM32=y
CONFIG_GPIO_SYSFS=y
CONFIG_GPIO_ST_MFX=y
CONFIG_POWER_RESET=y
CONFIG_POWER_RESET_SYSCON=y
# CONFIG_HWMON is not set
CONFIG_WATCHDOG=y
CONFIG_STPMU1_WATCHDOG=y
CONFIG_MFD_WM8994=y
CONFIG_MFD_STM32_LPTIMER=y
CONFIG_MFD_ST_MFX=y
CONFIG_MFD_STPMU1=y
CONFIG_REGULATOR=y
CONFIG_REGULATOR_FIXED_VOLTAGE=y
CONFIG_PROTECTION_CONSUMER=y
CONFIG_REGULATOR_GPIO=y
CONFIG_REGULATOR_STM32_VREFBUF=y
CONFIG_REGULATOR_STM32_PWR=y
CONFIG_REGULATOR_STPMU1=y
CONFIG_MEDIA_SUPPORT=y
CONFIG_MEDIA_CAMERA_SUPPORT=y
CONFIG_MEDIA_CEC_SUPPORT=y
CONFIG_MEDIA_CONTROLLER=y
CONFIG_VIDEO_V4L2_SUBDEV_API=y
CONFIG_V4L_PLATFORM_DRIVERS=y
CONFIG_VIDEO_STM32_DCMI=y
CONFIG_CEC_PLATFORM_DRIVERS=y
CONFIG_VIDEO_STM32_HDMI_CEC=y
# CONFIG_MEDIA_SUBDRV_AUTOSELECT is not set
CONFIG_VIDEO_OV5640=y
CONFIG_DRM=y
CONFIG_DRM_STM=y
CONFIG_DRM_STM_DSI=y
CONFIG_DRM_PANEL_RAYDIUM_RM68200=y
CONFIG_BACKLIGHT_LCD_SUPPORT=y
CONFIG_LCD_CLASS_DEVICE=y
CONFIG_BACKLIGHT_CLASS_DEVICE=y
CONFIG_SOUND=y
CONFIG_SND=y
CONFIG_SND_SOC=y
CONFIG_SND_SOC_STM32_SAI=y
CONFIG_SND_SOC_STM32_I2S=y
CONFIG_SND_SOC_STM32_SPDIFRX=y
CONFIG_SND_SOC_DMIC=y
CONFIG_SND_SOC_WM8994=y
CONFIG_SND_AUDIO_GRAPH_CARD=y
CONFIG_USB=y
CONFIG_USB_EHCI_HCD=y
CONFIG_USB_EHCI_HCD_PLATFORM=y
CONFIG_USB_OHCI_HCD=y
CONFIG_USB_OHCI_HCD_PLATFORM=y
CONFIG_USB_ACM=y
CONFIG_USB_STORAGE=y
CONFIG_USB_UAS=y
CONFIG_USB_DWC2=y
CONFIG_USB_GADGET=y
CONFIG_USB_CONFIGFS=y
CONFIG_USB_CONFIGFS_MASS_STORAGE=y
CONFIG_USB_CONFIGFS_F_LB_SS=y
CONFIG_USB_CONFIGFS_F_FS=y
CONFIG_USB_CONFIGFS_F_HID=y
CONFIG_MMC=y
CONFIG_MMC_STM32_SDMMC=y
CONFIG_NEW_LEDS=y
CONFIG_LEDS_CLASS=y
CONFIG_LEDS_GPIO=y
CONFIG_RTC_CLASS=y
CONFIG_RTC_DRV_STM32=y
CONFIG_DMADEVICES=y
CONFIG_STM32_DMA=y
CONFIG_STM32_DMAMUX=y
CONFIG_STM32_MDMA=y
CONFIG_MAILBOX_TEST=y
CONFIG_STM32_IPCC=y
# CONFIG_IOMMU_SUPPORT is not set
CONFIG_REMOTEPROC=y
CONFIG_STM32_RPROC=y
CONFIG_RPMSG_TTY=y
CONFIG_IIO=y
CONFIG_STM32_ADC_CORE=y
CONFIG_STM32_ADC=y
CONFIG_STM32_LPTIMER_CNT=y
CONFIG_STM32_DAC=y
CONFIG_IIO_STM32_LPTIMER_TRIGGER=y
CONFIG_PWM=y
CONFIG_PWM_STM32=y
CONFIG_PWM_STM32_LP=y
CONFIG_PHY_STM32_USBPHYC=y
CONFIG_EXT4_FS=y
# CONFIG_DNOTIFY is not set
# CONFIG_INOTIFY_USER is not set
CONFIG_VFAT_FS=y
CONFIG_NTFS_FS=y
CONFIG_UBIFS_FS=y
CONFIG_NLS_CODEPAGE_437=y
CONFIG_NLS_ISO8859_1=y
CONFIG_PRINTK_TIME=y
CONFIG_DYNAMIC_DEBUG=y
CONFIG_DEBUG_INFO=y
CONFIG_GDB_SCRIPTS=y
# CONFIG_ENABLE_WARN_DEPRECATED is not set
# CONFIG_ENABLE_MUST_CHECK is not set
CONFIG_DEBUG_FS=y
CONFIG_DEBUG_SECTION_MISMATCH=y
# CONFIG_SECTION_MISMATCH_WARN_ONLY is not set
CONFIG_MAGIC_SYSRQ=y
# CONFIG_SCHED_DEBUG is not set
# CONFIG_DEBUG_BUGVERBOSE is not set
# CONFIG_TRACING_EVENTS_GPIO is not set
CONFIG_DEBUG_USER=y
CONFIG_DEBUG_LL=y
CONFIG_STM32F7_DEBUG_UART=y
CONFIG_EARLY_PRINTK=y
CONFIG_CRC_DEV_STM32=y
CONFIG_HASH_DEV_STM32=y
CONFIG_CRYP_DEV_STM32=y
CONFIG_CRC_ITU_T=y
CONFIG_CRC7=y
```

## arch/arm/mach-stm32/Kconfig
```kconfig
menuconfig ARCH_STM32
	bool "STMicrolectronics STM32 family" if ARM_SINGLE_ARMV7M || ARCH_MULTI_V7
	select ARCH_HAS_RESET_CONTROLLER
	select CLKSRC_STM32
	select PINCTRL
	select RESET_CONTROLLER
	select STM32_EXTI
	help
	  Support for STMicroelectronics STM32 MCU/MPU family

if ARCH_STM32

if ARM_SINGLE_ARMV7M

config ARCH_STM32_MCU
	bool "STMicrolectronics STM32 MCU"
	select ARMV7M_SYSTICK
	help
	  Support for STMicroelectronics STM32 Microcontrollers.

config MACH_STM32F429
	bool "STMicrolectronics STM32F429"
	depends on ARCH_STM32_MCU
	default y

config MACH_STM32F469
	bool "STMicrolectronics STM32F469"
	depends on ARCH_STM32_MCU
	default y

config MACH_STM32F746
	bool "STMicrolectronics STM32F746"
	depends on ARCH_STM32_MCU
	default y

config MACH_STM32H743
	bool "STMicrolectronics STM32H743"
	depends on ARCH_STM32_MCU
	default y

endif

if ARCH_MULTI_V7

config ARCH_STM32_MPU
	bool "STMicrolectronics STM32 MPU"
	default y
	select ARM_GIC
	select HAVE_ARM_ARCH_TIMER
	select ARM_PSCI
	help
	  Support for STMicroelectronics STM32 Microprocessors.

config MACH_STM32MP157
	bool "STMicrolectronics STM32MP157"
	depends on ARCH_STM32_MPU
	default y

endif

endif
```
