## Documentation/devicetree/bindings/display/panel/raydium,rm68200.txt
```
Raydium Semiconductor Corporation RM68200 5.5" 720p MIPI-DSI TFT LCD panel

The Raydium Semiconductor Corporation RM68200 is a 5.5" 720x1280 TFT LCD
panel connected using a MIPI-DSI video interface.

Required properties:
  - compatible: "raydium,rm68200"
  - reg: the virtual channel number of a DSI peripheral

Optional properties:
  - reset-gpios: a GPIO spec for the reset pin (active low).
  - power-supply: regulator to provide the VCC supply voltage

Example:
&dsi {
	...
	panel@0 {
		compatible = "raydium,rm68200";
		reg = <0>;
		reset-gpios = <&gpioh 7 GPIO_ACTIVE_LOW>;
		power-supply = <&v1v8>;
	};
};
```

## Documentation/devicetree/bindings/gpu/st,gcnano.txt
```
VeriSilicon gcnano GPU integration into STMicroelectronics platform

- gcnano: VeriSilicon gcnano GPU ip
  Required properties:
  - compatible: "st,gcnano"
  - reg:
        Physical base address of the ip registers and length of memory mapped
        region.
  - contiguous-area:
        Reserved memory region (contiguous memory region) used by
        the VeriSilicon software stack (minimum is 32MB, recommended is greater
        than 192MB). The size of the contiguous area depends on the display
        resolution, the color depth.
  - interrupts:
        gcnano interrupt for the 3D pipeline
  - interrupt-names:
        names of the interrupts listed in interrupts property in
  - clocks:
        clocks to be managed by the driver
  - clock-names:
        names of the clocks listed by clocks property in the same order
  - resets:
        reset signal of the gcnano IP
  - status:
        either "okay" or "disabled"

Device node example:

/ {
	reserved-memory {
		#address-cells = <1>;
		#size-cells = <1>;
		ranges;

		gcnano_reserved: gpu@f8000000 {
			reg = <0xf8000000 0x8000000>;
			no-map;
		};
	};

	soc {

		...

		gcnano: gcnano@59000000 {
			compatible = "st,gcnano";
			reg = <0x59000000 0x800>;
			interrupts = <GIC_SPI 109 IRQ_TYPE_NONE>;
			interrupt-names = "irq_3d";
			clocks = <&rcc_clk GPU>, <&rcc_clk GPU_K>;
			clock-names = "clk_3d_ahb" ,"clk_3d_clk2x";
			resets = <&rcc_rst GPU_R>;
			status = "disable";
		};

		...

	};
};
```

## Documentation/devicetree/bindings/mailbox/stm32-ipcc.txt
```
* STMicroelectronics STM32 IPCC (Inter-Processor Communication Controller)

A mailbox is used to exchange messages between two processors.
The IPCC block provides a non blocking signaling mechanism to post and
retrieve messages in an atomic way.
The IPCC block provides the signaling for 2*N buffers. N buffers in the
direction from processor 0 to processor 1, and N buffers in the opposite
direction. This allows i.e. N different message types in each direction.
The mailbox buffers have to be located in a common memory, which is not part
of the IPCC block.
Number of buffers per processor (N) is defined in IPCC register.

Required properties:
- compatible: Should be "st,stm32-ipcc"
- reg: Offset and length of the device's register set
- clocks: The input clock of the IPCC instance
- interrupts: Interrupt specifiers for ipcc, one for each
  entry in interrupt-names.
- interrupt-names: 2 interrupt lines per processor
  rx buffer occupied => "rx?"
  tx buffer free (ack) => "tx?"
  2 processors per ipcc, where "?" is the processor index expressed
  as one digit "0" or "1".
- #mbox-cells: Must be 2
  <&phandle proc buf_id>
   phandle: Label name of controller
   proc: Index of your processor O or 1
   buf_id: Each processor buffer index (O to N)

Optional properties:
- wakeup-source: Flag to indicate this device can wake system (suspend/resume).
- interrupt-names : Name associated with interrupt line. Should be "wakeup?" if
  interrupt is to be used to wake system. 2 processors per ipcc, where "?"
  is the processor index expressed as one digit "0" or "1".

Example:
	ipcc: mailbox@4c001000 {
		compatible = "st,stm32-ipcc";
		#mbox-cells = <2>;
		reg = <0x4c001000 0x400>;
		interrupts-extended = <&intc GIC_SPI 100 IRQ_TYPE_NONE>,
				      <&intc GIC_SPI 101 IRQ_TYPE_NONE>,
				      <&intc GIC_SPI 103 IRQ_TYPE_NONE>,
				      <&intc GIC_SPI 104 IRQ_TYPE_NONE>,
				      <&aiec 62 1>, <&aiec 61 1>;
		interrupt-names = "rx0", "tx0", "rx1", "tx1",
				  "wakeup0", "wakeup1";
		clocks = <&rcc_clk IPCC>;
		wakeup-source;
		status = "disable";
	}

Client:
	mbox_test1: mailbox_test@1 {
		compatible = "mailbox-test";
		mboxes = <&ipcc 0 0>, <&ipcc 1 0>;
		mbox-names = "tx", "rx";
	};
```

## Documentation/devicetree/bindings/mfd/st,stm32-rcc.txt
```
STMicroelectronics STM32 Peripheral Reset Clock Controller
==========================================================

The RCC IP is both a reset and a clock controller.

Please also refer to reset.txt for common reset controller binding usage.

Please also refer to clock-bindings.txt for common clock controller
binding usage.


Required properties:
- compatible: "simple-mfd", "syscon"
- reg: should be register base and length as documented in the datasheet

- Sub-nodes:
  - compatible: "st,stm32mp1-rcc-clk"
	- #clock-cells: 1, device nodes should specify the clock in their
	  "clocks" property, containing a phandle to the clock device node,
	  an index specifying the clock to use.

  - compatible: "st,stm32mp1-rcc-rst"
	- #reset-cells: Shall be 1

  - compatible: "st,stm32mp1-rcc-pwr"
	- interrupts: interrupts for the RCC. Generic interrupt client node
	  bindings are described in interrupt-controller/interrupts.txt

Example:
	rcc: rcc@50000000 {
		compatible = "simple-mfd", "syscon";
		reg = <0x50000000 0x1000>;

		rcc_clk: rcc-clk@50000000 {
			#clock-cells = <1>;
			compatible = "st,stm32mp1-rcc-clk";
		};

		rcc_rst: rcc-reset@50000000 {
			#reset-cells = <1>;
			compatible = "st,stm32mp1-rcc-rst";
		};

		rcc-pwr@50000000 {
			compatible = "st,stm32mp1-rcc-pwr";
			interrupts = <GIC_SPI 5 IRQ_TYPE_NONE>, <GIC_SPI 145 IRQ_TYPE_NONE>;
		};
	};

Specifying clocks
=================

There are several types of clocks: pll, pll outputs (odf), bus clocks and
kernel clocks.
The index to use by the drivers in the device tree has been built as follows:
- bus clocks starting at index 5
- timer prescalers starting at index 115
- kernel clocks starting at index 120
- pll clocks starting at 170
- odf clocks starting at 175
- aux clocks starting at 190

A conversion file named stm32mp1-clks.h is available in <include/dt-bindings/clk>
It allows to use a constant character string instead of an offset by making
links such as:

..
..
#define DMA1 70
..
..

#define SPI6_K 138


Example:

	/* Accessing DMA1 clock */
	... {
		clocks = <&rcc_clk DMA1>
	};

	/* Accessing SPI6 kernel clock */
	... {
		clocks = <&rcc_clk SPI6_K>
	};

Specifying softreset control of devices
=======================================

Device nodes should specify the reset channel required in their "resets"
property, containing a phandle to the reset device node and an index specifying
which channel to use.
The index is the bit number within the RCC registers bank, starting from RCC
base address.
It is calculated as: index = register_offset / 4 * 32 + bit_offset.
Where bit_offset is the bit offset within the register.

For example on STM32MP1, for LTDC reset:
 ltdc = APB4_RSTSETR_offset / 4 * 32 + LTDC_bit_offset
      = 0x180 / 4 * 32 + 0 = 3072

The list of valid indices for STM32MP1 is available in:
include/dt-bindings/reset-controller/stm32mp1-resets.h

This file implements defines like:
#define LTDC_R	3072

example:

	ltdc {
		resets = <&rcc_rst LTDC_R>;
	};
```

## Documentation/devicetree/bindings/mfd/st-mfx.txt
```
STMicroelectronics Multi-Function eXpander

ST Multi-Function eXpander (MFX) is a slave controller using I2C for
communication with the main MCU. Its main features are gpio expansion, main
MCU IDD measurement (IDD is the amount of current that flows through VDD)
and resistive touchscreen controller.

Required properties:
- compatible: must be "st,mfx"
- reg: I2C address of the device
- interrupts: interrupt triggered by MFX_IRQ_OUT signal
- interrupt-parent: interrupt controller MFX is connected to

Optional nodes:

* GPIO eXpander
MFX provides 16 programmable GPIOs, and it is also possible to recover 8
alternate GPIOs if the main functions are not used (touchscreen controller and
IDD measurement not enabled).

Required properties:
- compatible : must be "st,mfx-gpio"
- gpio-controller: marks the device node as a GPIO controller
- #gpio-cells: should be <2>, the first cell is the GPIO offset on this GPIO
  controller, the second cell is the gpio flags in accordance with
  <dt-bindings/gpio/st-mfx-gpio.h>.

Example:

	mfx: mfx@42 {
		compatible = "st,mfx";
		reg = <0x42>;
		interrupts = <8 IRQ_TYPE_EDGE_RISING>;
		interrupt-parent = <&gpioi>;

		mfxgpio: mfx_gpio {
			compatible = "st,mfx-gpio";
			gpio-controller;
			#gpio-cells = <2>;
		};
	};
```

## Documentation/devicetree/bindings/mmc/st,stm32-sdmmc2.txt
```
* STMicroelectronics STM32 SDMMC2 controller

The highspeed MMC host controller on STM32 soc family
provides an interface for MMC, SD and SDIO types of memory cards.

This file documents differences between the core properties described
by mmc.txt and the properties used by the sdmmc2 driver.

Required properties:
 - compatible: Should be "st,stm32-sdmmc2"
 - reg: mmc controller base registers
 - interrupts: Should contain the interrupt number
 - clocks: Should contain phandle for the clock feeding the controller
 - resets: Should contain phandle for the reset feeding the controller

Optional property:
- st,idma: defines the idma mode
   0: idma disabled, pio mode (default, if no property)
   1: idma single buffer
   2: idma double buffer
- st,dirpol: for voltage tranceiver:
  by default IOs driven as output when direction signal is low
  but use it, if Voltage transceiver IOs driven as output when
  direction signal is high
- st,negedge: generate data & command on sdmmc clock falling edge

Example:
	sdmmc1: sdmmc@0x58005000 {
		compatible = "st,stm32-sdmmc2";
		reg = <0x58005000 0x1000>;
		interrupts = <GIC_SPI 49 IRQ_TYPE_NONE>;
		clocks = <&rcc SDMMC1_K>;
		resets = <&rcc SDMMC1_R>;
		st,idma = <1>;
		bus-width = <4>;
		cap-sd-highspeed;
		cap-mmc-highspeed;
		status = "disabled";
	};
```

## Documentation/devicetree/bindings/mtd/stm32-fmc-nand.txt
```
ST Microelectronics Flexible Memory Controller (FMC)
NAND Interface

Required properties:
- compatible: "st,stm32mp1-fmc"
- reg: Address range of the mtd chip
- reg-names: Should contain the reg names "fmc_regs", "fmc_common"
             and "fmc_attrib"
- interrupts: The interrupt number
- pinctrl-0: Standard Pinctrl phandle (see: pinctrl/pinctrl-bindings.txt)
- clocks: Use common clock framework
- resets: Reference to a reset controller asserting the FMC controller

Optional properties:
- dmas: DMA specifiers (see: dma/stm32-mdma.txt)
- dma-names: Must be "rxtx" and "ecc"
- nand-on-flash-bbt: see nand.txt
- nand-ecc-strength: see nand.txt
- nand-ecc-step-size: see nand.txt
- st,fmc_bank_used: NAND bank to use, default bank 3
- st,fmc_timings: array of 8 bytes for NAND timings. The meanings of
  these bytes are:
  byte 0 TCLR      : CLE to RE delay in number of AHB clock cycles, only 4 bits
                     are valid. Zero means one clockcycle, 15 means 16 clock
                     cycles.
  byte 1 TAR       : ALE to RE delay, 4 bits are valid. Same format as TCLR.
  byte 2 THIZ      : number of HCLK clock cycles during which the data bus is
                     kept in Hi-Z (tristate) after the start of a write access.
                     Only valid for write transactions. Zero means 1 cycle,
                     255 means 256 cycles.
  byte 3 TWAIT     : number of HCLK clock cycles to assert the command to the
                     NAND flash in response to SMWAITn. Zero means 1 cycle,
                     255 means 256 cycles.
  byte 4 THOLD_MEM : common memory space timing
                     number of HCLK clock cycles to hold the address (and data
                     when writing) after the command deassertion. Zero means
                     1 cycle, 255 means 256 cycles.
  byte 5 TSET_MEM  : common memory space timing
                     number of HCLK clock cycles to assert the address before
                     the command is asserted. Zero means 1 cycle, 255 means 256
                     cycles.
  byte 6 THOLD_ATT : attribute memory space timing
                     number of HCLK clock cycles to hold the address (and data
                     when writing) after the command deassertion. Zero means
                     1 cycle, 255 means 256 cycles.
  byte 7 TSET_ATT  : attribute memory space timing
                     number of HCLK clock cycles to assert the address before
                     the command is asserted. Zero means 1 cycle, 255 means 256
                     cycles.

The following ECC strength and step size are currently supported:
 - nand-ecc-strength = <1>, nand-ecc-step-size = <512> (HAMMING)
 - nand-ecc-strength = <4>, nand-ecc-step-size = <512> (BCH4)
 - nand-ecc-strength = <8>, nand-ecc-step-size = <512> (BCH8)

Example:

	fmc: flash@58002000 {
		compatible = "st,stm32mp1-fmc";
		reg = <0x58002000 0x1000>, <0x80000000 0x40000>,
		      <0x88000000 0x40000>;
		reg-names = "fmc_regs", "fmc_common";
		interrupts = <GIC_SPI 48 IRQ_TYPE_NONE>;
		dmas = <&mdma1 20 0x10 0x12000a0a 0x0 0x0 0>,
		       <&mdma1 21 0x10 0x12000a0a 0x0 0x0 0>;
		dma-names = "rxtx", "ecc";
		clocks = <&rcc FMC_K>;
		resets = <&rcc FMC_R>;

		nand-on-flash-bbt;
		nand-ecc-strength = <8>;
		nand-ecc-step-size = <512>;
		st,fmc_timings = /bits/ 8 <2 2 1 7 1 0 104 25>;
		st,fmc_bank_used = <3>;

		partition@0 {
			...
		};
	};
```

## Documentation/devicetree/bindings/mtd/stm32-quadspi.txt
```
* STMicroelectronics Quad Serial Peripheral Interface(QuadSPI)

Required properties:
- compatible: should be "st,stm32f469-qspi"
- reg: the first contains the register location and length.
       the second contains the memory mapping address and length
- reg-names: should contain the reg names "qspi" "qspi_mm"
- interrupts: should contain the interrupt for the device
- clocks: the phandle of the clock needed by the QSPI controller
- A pinctrl must be defined to set pins in mode of operation for QSPI transfer

Optional properties:
- dmas: DMA specifier for tx and rx
- dma-names: DMA request names should include "tx" and "rx" if present.
- resets: must contain the phandle to the reset controller.

A spi flash must be a child of the nor_flash node and could have some
properties. Also see jedec,spi-nor.txt.

Required properties:
- reg: chip-Select number (QSPI controller may connect 2 nor flashes)
- spi-max-frequency: max frequency of spi bus

Optional property:
- spi-rx-bus-width: see ../spi/spi-bus.txt for the description

Example:

qspi: spi@a0001000 {
	compatible = "st,stm32f469-qspi";
	reg = <0xa0001000 0x1000>, <0x90000000 0x10000000>;
	reg-names = "qspi", "qspi_mm";
	interrupts = <91>;
	dmas = <&dma2 7 3 0x416 0x0>
	       <&dma2 7 3 0x416 0x0;
	dma-names = "tx", "rx";
	resets = <&rcc STM32F4_AHB3_RESET(QSPI)>;
	clocks = <&rcc 0 STM32F4_AHB3_CLOCK(QSPI)>;
	pinctrl-names = "default";
	pinctrl-0 = <&pinctrl_qspi0>;

	flash@0 {
		reg = <0>;
		spi-rx-bus-width = <4>;
		spi-max-frequency = <108000000>;
		...
	};
};
```
